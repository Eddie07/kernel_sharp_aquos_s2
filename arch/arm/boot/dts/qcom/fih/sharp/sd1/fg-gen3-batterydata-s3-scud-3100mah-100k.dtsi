qcom,s3_scud_3100mah_100k {
	qcom, = <24>;
	/* #3068065_FIH_S3_Scud_3100mAh_averaged_MasterSlave_Aug28th2017*/
	qcom,max-voltage-uv = <4400000>;		/* 4.4V */
	qcom,fg-cc-cv-threshold-mv = <4390>;
	qcom,nom-batt-capacity-mah = <3100>;
	qcom,fastchg-current-ma = <3100>;		/* 0.5C (Step +0.5C) */
	qcom,batt-id-kohm = <100>;
	qcom,battery-beta = <3435>;
	qcom,battery-type = "s3_scud_3100mah_100k_Jan5th2018";
	qcom,checksum = <0x91CC>;
	qcom,gui-version = "PM660GUI - 0.0.0.44";
	qcom,fg-profile-data = [
		 68 1F B3 05
		 6D 0A 51 06
		 4A 1D DF E5
		 4B 0B F9 14
		 24 19 61 22
		 6D 3C A1 4B
		 56 00 00 00
		 11 00 00 00
		 00 00 3E CA
		 19 CD 0F C5
		 3A 00 08 00
		 29 E2 CF E4
		 92 04 59 02
		 C7 0C 9C 01
		 69 E5 FB 23
		 3E 06 09 20
		 27 00 14 00
		 E0 1F 82 05
		 77 0A 5B 06
		 07 1D CD FB
		 5B 05 C3 00
		 92 19 54 22
		 70 3C 94 4B
		 5E 00 00 00
		 0D 00 00 00
		 00 00 F6 07
		 03 00 D1 C3
		 22 00 00 00
		 1E EA CF E4
		 21 FC 1F 01
		 88 07 92 02
		 EE ED 5F 22
		 BA 33 CC FF
		 07 10 00 00
		 A6 0C 66 46
		 22 00 40 00
		 9F 01 0A FA
		 FF 00 00 00
		 00 00 00 00
		 00 00 00 00
		 00 00 00 00
		 00 00 00 00
		 00 00 00 00
		 00 00 00 00
		 00 00 00 00
		 00 00 00 00
		 00 00 00 00
		 00 00 00 00
		 00 00 00 00
		 00 00 00 00
		 00 00 00 00
		 00 00 00 00
		 00 00 00 00
		 00 00 00 00
		 00 00 00 00
		 00 00 00 00
	];
};
