/* DRG preEVT SDM636 */

/* MemMap parts */
#include "../common/memmap-evb.dtsi"

/* Common DT Info */
#include "common/common_info_sdm_v3.dtsi"

/* SYSTEM parts */
#include "common/system-preEVT-630-hd1.dtsi"

/* External LDO control */
#include "ext-reguator/fixed-regulator-EVT-v2.dtsi"

/* Keypad parts */
#include "misc/keypad.dtsi"

/* PMIC parts */

/* GPIO parts */

/* Peripheral */

/* Charging */
#include "charger/charger-evt1-hd1.dtsi"
//#include "charger/drg-setting.dtsi"

/* Audio */
#include "audio/sdm660-internal-codec-hd1.dtsi"

/* Camera */
#include "camera/camera-HD1.dtsi"

/* Haptic */
#include "misc/haptics-hal1.1_HD1.dtsi"

/*Leds*/
#include "leds/heineken_leds_rgb_hd1.dtsi"

/* SD */
#include "misc/sd-evb.dtsi"

/* Fingerprint */
//#include "fingerprint/fingerprint-gf3208-evt.dtsi"
#include "fingerprint/fingerprint-microarray.dtsi"

/* Sensor */
/* NO HALL Sensor */

/*Touch*/

#include "touch/himax.dtsi"

/* USB */
#include "usb/microUSB_nd1.dtsi"



/* LCM */
/* SW4-HL-Display-himax8399 */
#include "display/dsi-panel-hx8399c-fhd-plus-video-hd1.dtsi"

/* multivendor */
#include "misc/multivendor.dtsi"



