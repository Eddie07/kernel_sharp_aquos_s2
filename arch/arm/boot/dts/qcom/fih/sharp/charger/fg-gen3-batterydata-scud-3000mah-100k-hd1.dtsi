		qcom,hd1_scud_3000mah_100k {
			qcom, = <0x18>;
			qcom,max-voltage-uv = <0x432380>;
			qcom,fg-cc-cv-threshold-mv = <0x1126>;
			qcom,nom-batt-capacity-mah = <0xbb8>;
			qcom,fastchg-current-ma = <0x834>;
			qcom,batt-id-kohm = <0x64>;
			qcom,battery-beta = <0xd6b>;
			qcom,battery-type = "hd1_scud_3000mah_100k";
			qcom,checksum = <0xb110>;
			qcom,gui-version = "PM660GUI - 0.0.0.36";
			qcom,fg-profile-data = <0x6c1fb005 0x720a9ffc 0x7b1d53f4 0x9012d91d 0x1180c23 0xb0456252 0x56000000 0x10000000 0x89bb 0xe4cd98bd 0x24000800 0x23ea11ed 0x720561fb 0xff0c970a 0x72079e32 0x29060920 0x27001400 0xd01f8705 0x7f0a4e06 0x681d3200 0xf0bc314 0x5619d022 0x7e450553 0x55000000 0xe000000 0x3acc 0xecba7cab 0x1a000000 0xbeeb11ed 0x6b06cbf3 0xc5fce7f2 0x9c02f022 0xc633ccff 0x7100000 0x140c6646 0x1a004000 0x97010afa 0xff000000 0x0 0x0 0x0 0x0 0x0 0x0 0x0 0x0 0x0 0x0 0x0 0x0 0x0 0x0 0x0 0x0 0x0 0x0>;
		};

