qcom,sat_scud_2700mah_200k_4350mv {
			qcom, = <24>;
			qcom,max-voltage-uv = <0x426030>;
			qcom,fg-cc-cv-threshold-mv = <0x10f4>;
			qcom,nom-batt-capacity-mah = <0xa8c>;
			qcom,fastchg-current-ma = <0x834>;
			qcom,batt-id-kohm = <200>;
			qcom,battery-beta = <0xd6b>;
			qcom,battery-type = "sat_scud_2700mah_200k_4350mv";
			qcom,checksum = <0x24e5>;
			qcom,gui-version = "PM660GUI - 0.0.0.45";
			qcom,fg-profile-data = <0x381e6607 0xdb01e6d4 0xe41cf601 0xa20dce0a 0xc3170d2a 0xf14dd45a 0x63000000 0xf000000 0xc0c4 0xacc56fc2 0x21000800 0x7bdb8ae4 0x83fdad00 0x4201ec12 0xbff5a923 0x1c060920 0x27001400 0x3d1fadfc 0x7d032307 0xcc1cd802 0x330c1012 0x8018002a 0xb94d965b 0x68000000 0xd000000 0xd5d5 0x34c34bca 0x1b000000 0x99ea8ae4 0x75f483eb 0x87ea930a 0xb3cbcd1a 0xa433ccff 0x7100000 0xfd0a6646 0x1b004000 0xbe010afa 0xff000000 0x0 0x0 0x0 0x0 0x0 0x0 0x0 0x0 0x0 0x0 0x0 0x0 0x0 0x0 0x0 0x0 0x0 0x0>;
		};


