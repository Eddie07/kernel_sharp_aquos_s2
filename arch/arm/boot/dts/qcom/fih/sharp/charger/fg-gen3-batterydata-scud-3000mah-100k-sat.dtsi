qcom,sat_scud_3000mah_100k_4350mv {
			qcom, = <24>;
			qcom,max-voltage-uv = <0x426030>;
			qcom,fg-cc-cv-threshold-mv = <0x10f4>;
			qcom,nom-batt-capacity-mah = <0xb90>;
			qcom,fastchg-current-ma = <0x834>;
			qcom,batt-id-kohm = <100>;
			qcom,battery-beta = <0xd6b>;
			qcom,battery-type = "sat_scud_3000mah_100k_4350mv";
			qcom,checksum = <0x8f2>;
			qcom,gui-version = "PM660GUI - 0.0.0.45";
			qcom,fg-profile-data = <0xf71e6506 0x84031807 0xcc1c1802 0x8d0dbe0a 0x918d123 0x2e449f5a 0x70000000 0xf000000 0x8fc3 0xa3cc41aa 0x4c000800 0x5ecb8ddc 0x79044602 0x220d65f5 0xfbec182a 0x43060920 0x27001400 0xcc1f9d05 0x640a6c06 0xcd1cf102 0x130c1a12 0x8818102a 0x904dfc5b 0x6c000000 0xd000000 0x17d5 0xb7c3a6cb 0x25000000 0x9e38ddc 0x3b0665f3 0xbde3100a 0xdce31023 0xb733ccff 0x7100000 0xd40b6646 0x25004000 0xd5010afa 0xff000000 0x0 0x0 0x0 0x0 0x0 0x0 0x0 0x0 0x0 0x0 0x0 0x0 0x0 0x0 0x0 0x0 0x0 0x0>;
		};

