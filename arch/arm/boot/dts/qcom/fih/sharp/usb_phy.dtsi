&qusb_phy0{
		reg = <0x0c012000 0x180>,
			<0x01fcb24c 0x4>,
			<0x00188018 0x4>;
		reg-names = "qusb_phy_base",
			"tcsr_clamp_dig_n_1p8",
			"ref_clk_addr";
			
    /delete-property/ qcom,tune2-efuse-bit-pos;
    /delete-property/ qcom,tune2-efuse-num-bits;
			
		qcom,qusb-phy-init-seq = <0xf8 0x80
					0x33 0x84
					0x83 0x88
					0xc7 0x8c
					0x30 0x08
					0x79 0x0c
					0x21 0x10
					0x14 0x9c
					0x9f 0x1c
					0x00 0x18>;
};