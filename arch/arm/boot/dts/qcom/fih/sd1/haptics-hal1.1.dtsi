&spmi_bus {
	qcom,pm660@1 {
		 pm660_haptics: qcom,haptic@c000 {
	status = "okay";
	qcom,wave-play-rate-us = <5000>;
	qcom,wave-shape = "sine";
	qcom,play-mode = "buffer";
	qcom,vmax-mv = <2750>;
	qcom,int-pwm-freq-khz = <253>;
	qcom,brake-pattern = [02 01 00 00];
	qcom,wave-samples = [3e 3e 3e 3e 3e 3e 3e 3e];
	qcom,wave-rep-cnt = <1>;
	qcom,wave-samp-rep-cnt = <1>;
	qcom,drive-period-code-min-limit-percent-variation = <20>;
	qcom,drive-period-code-max-limit-percent-variation = <20>;
		};
	};
};
