qcom,s3_scud_3200mah_100k_jan17th2018 {
	qcom, = <24>;
	/* #3285720_FIH_S3_Scud_3200mAh_averaged_MasterSlave_Jan17th2018*/
	qcom,max-voltage-uv = <4400000>;
	qcom,nom-batt-capacity-mah = <3200>;
	qcom,batt-id-kohm = <100>;
	qcom,battery-beta = <3435>;
	qcom,fastchg-current-ma = <3100>;		/* 0.5C (Step +0.5C) */
	qcom,fg-cc-cv-threshold-mv = <4390>;
	qcom,battery-type = "s3_scud_3200mah_100k_jan17th2018";
	qcom,checksum = <0xB1BD>;
	qcom,gui-version = "PM660GUI - 0.0.0.45";
	qcom,fg-profile-data = [
		 61 1F D8 05
		 42 0A 8C 06
		 E0 1C D5 01
		 0C 04 46 0A
		 BC 17 DB 23
		 5C 44 59 5A
		 78 00 00 00
		 10 00 00 00
		 00 00 72 CA
		 EC D5 CD BD
		 34 00 08 00
		 0B 00 E2 E5
		 0B 05 EF 01
		 09 0C 72 DA
		 0D DC AD 23
		 3D 06 09 20
		 27 00 14 00
		 E7 1F 62 05
		 A8 0A 31 FC
		 C1 1C 09 03
		 F3 15 39 12
		 89 18 CF 23
		 EC 4D 27 5B
		 6B 00 00 00
		 0E 00 00 00
		 00 00 27 D5
		 82 C3 0B D2
		 1F 00 00 00
		 8E E3 E2 E5
		 5A 06 AE F3
		 7E ED 08 0A
		 CA EA 35 22
		 B3 33 CC FF
		 07 10 00 00
		 84 0C 66 46
		 1F 00 40 00
		 B6 01 0A FA
		 FF 00 00 00
		 00 00 00 00
		 00 00 00 00
		 00 00 00 00
		 00 00 00 00
		 00 00 00 00
		 00 00 00 00
		 00 00 00 00
		 00 00 00 00
		 00 00 00 00
		 00 00 00 00
		 00 00 00 00
		 00 00 00 00
		 00 00 00 00
		 00 00 00 00
		 00 00 00 00
		 00 00 00 00
		 00 00 00 00
		 00 00 00 00
	];
};
